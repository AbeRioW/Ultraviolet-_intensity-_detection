#include "oled_1315.h"
#include "gpio.h"
#include "math.h"

// OLED显存缓冲区
static uint8_t OLED_GRAM[OLED_PAGES][OLED_WIDTH];

// 微秒级延时
static void OLED_Delay_us(uint32_t us)
{
    uint32_t i;
    for(i = 0; i < us * 8; i++)
    {
        __NOP();
    }
}

// 延时函数
static void OLED_Delay(uint32_t ms)
{
    HAL_Delay(ms);
}

// I2C起始信号
static void I2C_Start(void)
{
    HAL_GPIO_WritePin(OLED_SDA_GPIO_Port, OLED_SDA_Pin, GPIO_PIN_SET);
    HAL_GPIO_WritePin(OLED_SCL_GPIO_Port, OLED_SCL_Pin, GPIO_PIN_SET);
    OLED_Delay_us(5);
    HAL_GPIO_WritePin(OLED_SDA_GPIO_Port, OLED_SDA_Pin, GPIO_PIN_RESET);
    OLED_Delay_us(5);
    HAL_GPIO_WritePin(OLED_SCL_GPIO_Port, OLED_SCL_Pin, GPIO_PIN_RESET);
    OLED_Delay_us(5);
}

// I2C停止信号
static void I2C_Stop(void)
{
    HAL_GPIO_WritePin(OLED_SCL_GPIO_Port, OLED_SCL_Pin, GPIO_PIN_RESET);
    HAL_GPIO_WritePin(OLED_SDA_GPIO_Port, OLED_SDA_Pin, GPIO_PIN_RESET);
    OLED_Delay_us(5);
    HAL_GPIO_WritePin(OLED_SCL_GPIO_Port, OLED_SCL_Pin, GPIO_PIN_SET);
    OLED_Delay_us(5);
    HAL_GPIO_WritePin(OLED_SDA_GPIO_Port, OLED_SDA_Pin, GPIO_PIN_SET);
    OLED_Delay_us(5);
}

// I2C等待应答
static void I2C_WaitAck(void)
{
    HAL_GPIO_WritePin(OLED_SCL_GPIO_Port, OLED_SCL_Pin, GPIO_PIN_SET);
    OLED_Delay_us(5);
    HAL_GPIO_WritePin(OLED_SCL_GPIO_Port, OLED_SCL_Pin, GPIO_PIN_RESET);
    OLED_Delay_us(5);
}

// I2C发送一个字节
static void I2C_SendByte(uint8_t dat)
{
    uint8_t i;
    for(i = 0; i < 8; i++)
    {
        if(dat & 0x80)
            HAL_GPIO_WritePin(OLED_SDA_GPIO_Port, OLED_SDA_Pin, GPIO_PIN_SET);
        else
            HAL_GPIO_WritePin(OLED_SDA_GPIO_Port, OLED_SDA_Pin, GPIO_PIN_RESET);
        
        OLED_Delay_us(5);
        HAL_GPIO_WritePin(OLED_SCL_GPIO_Port, OLED_SCL_Pin, GPIO_PIN_SET);
        OLED_Delay_us(5);
        HAL_GPIO_WritePin(OLED_SCL_GPIO_Port, OLED_SCL_Pin, GPIO_PIN_RESET);
        OLED_Delay_us(5);
        dat <<= 1;
    }
    I2C_WaitAck();
}

// 向OLED写入命令
void OLED_WriteCommand(uint8_t cmd)
{
    I2C_Start();
    I2C_SendByte(OLED_ADDRESS);
    I2C_SendByte(OLED_CMD);
    I2C_SendByte(cmd);
    I2C_Stop();
}

// 向OLED写入数据
void OLED_WriteData(uint8_t data)
{
    I2C_Start();
    I2C_SendByte(OLED_ADDRESS);
    I2C_SendByte(OLED_DATA);
    I2C_SendByte(data);
    I2C_Stop();
}

// OLED初始化
void OLED_Init(void)
{
    OLED_Delay(100);  // 等待OLED上电稳定
    
    OLED_WriteCommand(0xAE);  // 关闭显示
    OLED_Delay(10);
    
    OLED_WriteCommand(0xD5);  // 设置显示时钟分频/振荡频率
    OLED_WriteCommand(0x80);  // 建议值
    OLED_Delay(10);
    
    OLED_WriteCommand(0xA8);  // 设置多路复用率
    OLED_WriteCommand(0x3F);  // 1/64 duty
    OLED_Delay(10);
    
    OLED_WriteCommand(0xD3);  // 设置显示偏移
    OLED_WriteCommand(0x00);  // 无偏移
    OLED_Delay(10);
    
    OLED_WriteCommand(0x40);  // 设置显示开始行 [0x40-0x7F]
    OLED_Delay(10);
    
    OLED_WriteCommand(0xA1);  // 设置段重映射 (左右反置)
    OLED_Delay(10);
    
    OLED_WriteCommand(0xC8);  // 设置COM输出扫描方向 (上下反置)
    OLED_Delay(10);
    
    OLED_WriteCommand(0xDA);  // 设置COM引脚硬件配置
    OLED_WriteCommand(0x12);  // 替代COM引脚配置
    OLED_Delay(10);
    
    OLED_WriteCommand(0x81);  // 设置对比度控制
    OLED_WriteCommand(0xCF);  // 对比度值
    OLED_Delay(10);
    
    OLED_WriteCommand(0xD9);  // 设置预充电周期
    OLED_WriteCommand(0xF1);  // 建议值
    OLED_Delay(10);
    
    OLED_WriteCommand(0xDB);  // 设置VCOMH取消选择级别
    OLED_WriteCommand(0x30);  // 建议值
    OLED_Delay(10);
    
    OLED_WriteCommand(0xA4);  // 全局显示开启 (输出跟随RAM内容)
    OLED_Delay(10);
    
    OLED_WriteCommand(0xA6);  // 设置正常/反色显示 (A6=正常, A7=反色)
    OLED_Delay(10);
    
    OLED_WriteCommand(0x8D);  // 设置电荷泵
    OLED_WriteCommand(0x14);  // 使能电荷泵
    OLED_Delay(10);
    
    OLED_WriteCommand(0xAF);  // 开启显示
    OLED_Delay(10);
    
    OLED_Clear();
    OLED_SetPos(0, 0);
}

// OLED清屏
void OLED_Clear(void)
{
    uint8_t i, j;
    for(i = 0; i < OLED_PAGES; i++)
    {
        for(j = 0; j < OLED_WIDTH; j++)
        {
            OLED_GRAM[i][j] = 0x00;
        }
    }
    OLED_Refresh();
}

// OLED开启显示
void OLED_DisplayOn(void)
{
    OLED_WriteCommand(0x8D);  // 电荷泵设置
    OLED_WriteCommand(0x14);  // 使能电荷泵
    OLED_WriteCommand(0xAF);  // 开启显示
}

// OLED关闭显示
void OLED_DisplayOff(void)
{
    OLED_WriteCommand(0x8D);  // 电荷泵设置
    OLED_WriteCommand(0x10);  // 关闭电荷泵
    OLED_WriteCommand(0xAE);  // 关闭显示
}

// 设置光标位置
void OLED_SetPos(uint8_t x, uint8_t y)
{
    OLED_WriteCommand(0xB0 + y);              // 设置页地址
    OLED_WriteCommand(((x & 0xF0) >> 4) | 0x10);  // 设置列高地址
    OLED_WriteCommand((x & 0x0F));            // 设置列低地址
}

// 在指定位置画点
void OLED_DrawPoint(uint8_t x, uint8_t y, uint8_t t)
{
    uint8_t pos, bx, temp = 0;
    if(x > OLED_WIDTH - 1 || y > OLED_HEIGHT - 1) return;
    
    pos = y / 8;
    bx = y % 8;
    temp = 1 << bx;
    
    if(t) OLED_GRAM[pos][x] |= temp;
    else OLED_GRAM[pos][x] &= ~temp;
}

// 6x8标准ASCII字符字模
static const uint8_t F6x8[][6] =
{
    {0x00,0x00,0x00,0x00,0x00,0x00},// sp
    {0x00,0x00,0x2f,0x00,0x00,0x00},// !
    {0x00,0x07,0x00,0x07,0x00,0x00},// "
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    {0x08,0x1C,0x2A,0x08,0x08,0x00} // <-
};

// 8x16标准ASCII字符字模
static const uint8_t F8X16[]=
{
    0x00,0x00,0x00,0x00,0x00,0x00,0x00,0x00,0x00,0x00,0x00,0x00,0x00,0x00,0x00,0x00,//sp 0
    0x00,0x00,0x00,0xF8,0x00,0x00,0x00,0x00,0x00,0x00,0x00,0x33,0x30,0x00,0x00,0x00,//! 1
    0x00,0x16,0x0E,0x00,0x16,0x0E,0x00,0x00,0x00,0x00,0x00,0x00,0x00,0x00,0x00,0x00,//" 2
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    0x00,0x06,0x01,0x01,0x02,0x02,0x04,0x04,0x00,0x00,0x00,0x00,0x00,0x00,0x00,0x00,//~ 94
};

// 显示一个字符
void OLED_ShowChar(uint8_t x, uint8_t y, uint8_t chr, uint8_t size)
{
    uint8_t c = chr - ' ';
    uint8_t i, j;
    
    if(size == 8)  // 6x8字体
    {
        if(x > OLED_WIDTH - 6 || y > OLED_PAGES - 1) return;
        
        for(i = 0; i < 6; i++)
        {
            OLED_GRAM[y][x + i] = F6x8[c][i];
        }
    }
    else if(size == 16)  // 8x16字体
    {
        if(x > OLED_WIDTH - 8 || y > OLED_PAGES - 2) return;
        
        for(i = 0; i < 8; i++)
        {
            OLED_GRAM[y][x + i] = F8X16[c * 16 + i];
            OLED_GRAM[y + 1][x + i] = F8X16[c * 16 + i + 8];
        }
    }
}

// 显示字符串
void OLED_ShowString(uint8_t x, uint8_t y, uint8_t *chr, uint8_t size)
{
    uint8_t j = 0;
    while(chr[j] != '\0')
    {
        OLED_ShowChar(x, y, chr[j], size);
        if(size == 8) x += 6;
        else if(size == 16) x += 8;
        
        if(x > OLED_WIDTH - (size == 8 ? 6 : 8))
        {
            x = 0;
            y += (size == 8 ? 1 : 2);
        }
        j++;
    }
}

// 显示数字
void OLED_ShowNum(uint8_t x, uint8_t y, uint32_t num, uint8_t len, uint8_t size)
{
    uint8_t t, temp;
    uint8_t enshow = 0;
    
    for(t = 0; t < len; t++)
    {
        temp = (num / (uint32_t)pow(10, len - t - 1)) % 10;
        if(enshow == 0 && t < (len - 1))
        {
            if(temp == 0)
            {
                OLED_ShowChar(x + (size == 8 ? 6 : 8) * t, y, ' ', size);
                continue;
            }
            else
            {
                enshow = 1;
            }
        }
        OLED_ShowChar(x + (size == 8 ? 6 : 8) * t, y, temp + '0', size);
    }
}

// 显示汉字（示例，需要添加汉字字模）
void OLED_ShowCHinese(uint8_t x, uint8_t y, uint8_t no)
{
    // 这里需要添加汉字字模数据
    // 示例：显示16x16汉字，每个汉字占用32字节
    // 根据no索引从字模数组中取出对应汉字显示
}

// 显示BMP图片
void OLED_DrawBMP(uint8_t x0, uint8_t y0, uint8_t x1, uint8_t y1, uint8_t BMP[])
{
    uint16_t j = 0;
    uint8_t x, y;
    
    if(y1 % 8 == 0) y = y1 / 8;
    else y = y1 / 8 + 1;
    
    for(y = y0; y < y1; y++)
    {
        OLED_SetPos(x0, y);
        for(x = x0; x < x1; x++)
        {
            OLED_WriteData(BMP[j++]);
        }
    }
}

// 刷新显存到OLED
void OLED_Refresh(void)
{
    uint8_t i, j;
    for(i = 0; i < OLED_PAGES; i++)
    {
        OLED_SetPos(0, i);
        for(j = 0; j < OLED_WIDTH; j++)
        {
            OLED_WriteData(OLED_GRAM[i][j]);
        }
    }
}

// OLED测试函数
void OLED_Test(void)
{
    OLED_Clear();
    OLED_ShowString(0, 0, (uint8_t*)"OLED Test", 8);
	  OLED_ShowString(0, 1, (uint8_t*)"OLED Test", 8);
    OLED_ShowString(0, 2, (uint8_t*)"SSD1315", 16);
    OLED_ShowString(0, 4, (uint8_t*)"128x64", 16);
    OLED_ShowNum(0, 6, 2026, 4, 16);
    OLED_Refresh();
}
